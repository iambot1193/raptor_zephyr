## CMakeLists.txt
```
cmake_minimum_required(VERSION 3.20.0)

find_package(Zephyr REQUIRED HINTS $ENV{ZEPHYR_BASE})

project(raptor_print_app) # Nome do seu projeto de print

target_sources(app PRIVATE src/main.c)
```

## prj.conf
```kconfig
# Log limpo para Windows
CONFIG_LOG=y
CONFIG_LOG_MODE_IMMEDIATE=y
CONFIG_LOG_BACKEND_SHOW_COLOR=n
CONFIG_LOG_BACKEND_UART=y

# Tempo real
CONFIG_QEMU_ICOUNT=y
CONFIG_QEMU_ICOUNT_SLEEP=y

# Console
CONFIG_CONSOLE=y
CONFIG_UART_CONSOLE=y
CONFIG_STDOUT_CONSOLE=y
CONFIG_MINIMAL_LIBC=y
```

## src/main.c
```c
#include <zephyr/kernel.h>
#include <zephyr/logging/log.h>

LOG_MODULE_REGISTER(raptor_app, LOG_LEVEL_INF);

int main(void)
{
    LOG_INF("Hello World! This is Raptor!");
    return 0;
}
```
